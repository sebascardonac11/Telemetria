#include "Ucglib.h"

#include <SPI.h>
const unsigned char epd_bitmap_logo_icon[] PROGMEM = {
  0xff, 0xff, 0xff, 0xff, 0xff, 0xff, 0xff, 0xff, 0xff, 0xff, 0xff, 0xff, 0xff, 0xff, 0xff, 0xff,
  0xff, 0xff, 0xff, 0xff, 0xff, 0xff, 0xff, 0xff, 0xff, 0xff, 0xff, 0xff, 0xff, 0xff, 0xff, 0xff,
  0xff, 0xff, 0xff, 0xff, 0xff, 0xff, 0xff, 0xff, 0xff, 0xff, 0xff, 0xff, 0xff, 0xff, 0xff, 0xff,
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  0xff, 0xff, 0xff, 0xff, 0xff, 0xff, 0xff, 0xff, 0xff, 0xff, 0xff, 0xff, 0xff, 0xff, 0xff, 0xff
};
class TftScreen {
  // 'logo-icon', 128x169px


private:
  int flag = 10;
  String opt = "";

  // pin definition for the Uno
  int8_t cs = 30;
  int8_t dc = 29;
  int8_t rst = 31;

  Ucglib_ST7735_18x128x160_HWSPI ucg;

  // Array of all bitmaps for convenience. (Total bytes used to store images in PROGMEM = 2720)
  const int epd_bitmap_allArray_LEN = 1;
  const unsigned char* epd_bitmap_allArray[1] = {
    epd_bitmap_logo_icon
  };


public:

  TftScreen()
    : ucg(29, 30, 31) {
    // this->init();
  }

  void init() {

    ucg.begin(UCG_FONT_MODE_SOLID);
    //ucg.begin(UCG_FONT_MODE_TRANSPARENT);
    ucg.clearScreen();
    ucg.setRotate90();

    ucg.setFont(ucg_font_inb27_mr);
    //ucg.setColor(255, 255, 255);
    ucg.setColor(0,255, 255, 0);
     ucg.setColor(1,0, 0, 0);
    ucg.setPrintPos(0, 30);
    ucg.print("Sebas84");

    ucg.setFont(ucg_font_ncenR12_tr);
    ucg.setPrintPos(0, 80);
    ucg.print("v1.0");

    this->opt = "init";
  }
  void printHome(int sat, String text) {
    if (this->opt != "printHome") {
      this->opt = "printHome";
      ucg.clearScreen();
    }
    ucg.setFont(ucg_font_inb27_mr);
    ucg.setPrintPos(0, 30);
    ucg.print("Sebas84");

    ucg.setFont(ucg_font_ncenR12_tr);
    ucg.setPrintPos(0, 80);
    ucg.print(text);
  }
  /**
   * @brief Laps, time, satellites,
   * 
   * @param time 
   * @param text 
   */
  void printLaptimer(String time, String sat, float speed, String laps, String date) {
    if (this->opt != "printLaptimer") {
      this->opt = "printLaptimer";
      ucg.clearScreen();
      ucg.setFont(ucg_font_ncenR12_tr);
      //Satellites
      ucg.setPrintPos(0, 50);
      ucg.print("Sat: ");
      //Date
      ucg.setPrintPos(0, 70);
      ucg.print("Fecha: ");
      //Speed
      ucg.setPrintPos(0, 90);
      ucg.print("Velocidad: ");
      //Laps
      ucg.setPrintPos(0, 110);
      ucg.print("Vueltas: ");
      //Footer
      ucg.setFont(ucg_font_ncenR12_tr);
      ucg.setPrintPos(100, 120);
      ucg.print("Sebas84");
      
    }
    //Time
    ucg.setFont(ucg_font_inb27_mf);
    ucg.setPrintPos(0, 30);
    ucg.print(time);
    //Satellites
   ucg.setFont(ucg_font_helvR12_hr);
    ucg.setPrintPos(50, 50);
    ucg.print(sat);
    //Date
    ucg.setFont(ucg_font_helvR12_hr);
    ucg.setPrintPos(80, 70);
    ucg.print(date);

    //Speed
    ucg.setFont(ucg_font_helvR12_hr);
    ucg.setPrintPos(80, 90);
    ucg.print(speed);

    //Laps
    ucg.setFont(ucg_font_helvR12_hr);
    ucg.setPrintPos(80, 110);
    ucg.print(laps);
  }
  void printMenu(int selected) {
  }
  void printText(String text) {
    if (this->opt != "printText") {
      ucg.clearScreen();
      ucg.setFont(ucg_font_ncenR12_tr);
      this->opt = "printText";
    }

    ucg.setPrintPos(80, 95);
    ucg.print(text);
  }
  void printSuspension(String front, String rear) {
    if (this->opt != "printSuspension") {
      this->opt = "printSuspension";
      ucg.clearScreen();
      ucg.setFont(ucg_font_inb19_mr);
      ucg.setPrintPos(0, 30);
      ucg.print("Suspension");
    }
    //Front
    ucg.setFont(ucg_font_ncenR12_tr);
    ucg.setPrintPos(0, 65);
    ucg.print("Delantera: ");
    ucg.setFont(ucg_font_helvR12_hr);
    ucg.setPrintPos(100, 65);
    ucg.print(front);

    //Rear
    ucg.setFont(ucg_font_ncenR12_tr);
    ucg.setPrintPos(0, 85);
    ucg.print("Trasera: ");
    ucg.setFont(ucg_font_helvR12_hr);
    ucg.setPrintPos(100, 85);
    ucg.print(rear);
    //Footer
    ucg.setFont(ucg_font_ncenR12_tr);
    ucg.setPrintPos(100, 120);
    ucg.print("Sebas84");
  }
  void printGPS(String sat, String log, String lat) {
  }
  void printRPMS(String rpm) {
    if (this->opt != "printRPMS") {
      this->flag = 0;
      ucg.clearScreen();
      this->opt = "printRPMS";
      //Time
      ucg.setFont(ucg_font_inb27_mr);
      ucg.setPrintPos(0, 30);
      ucg.print("RPMS");
    }
    this->flag++;
    //RPMS
    ucg.setFont(ucg_font_helvR12_hr);
    ucg.setPrintPos(80, 95);
    ucg.print(rpm);

    //Footer
    ucg.setFont(ucg_font_ncenR12_tr);
    ucg.setPrintPos(100, 120);
    ucg.print("Sebas84");
  }
  void printHeader() {
  }


  void printLastLap(String time, int lap) {
    if (this->opt != "printLastLap") {
      this->opt = "printLastLap";
      ucg.clearScreen();
      ucg.setFont(ucg_font_inb27_mr);
      ucg.setPrintPos(0, 30);
      ucg.print("RPMS");
      ucg.setFont(ucg_font_ncenR12_tr);
    }

    ucg.setPrintPos(80, 95);
    ucg.print(time);
  }
  void printSession() {
  }
};